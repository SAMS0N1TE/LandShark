## main/Kconfig.projbuild
```kconfig
menu "ESP32-P4 SDR Tool"

    orsource "$IDF_PATH/examples/common_components/env_caps/$IDF_TARGET/Kconfig.env_caps"

    config APP_QUIT_PIN
        int "App Quit button GPIO pin"
        range ENV_GPIO_RANGE_MIN ENV_GPIO_IN_RANGE_MAX
        default 0
        help
            GPIO pin used as the quit button. Pulled up by default; pressing
            to GND triggers an orderly shutdown of the USB host and tasks.

    menu "User Interface"

        config ENABLE_TUI
            bool "Enable terminal UI (TUI)"
            default y
            help
                When enabled, the device renders a full-screen ANSI terminal UI
                over UART0 with a plane table, event log, waterfall, and
                settings pages. Requires a 128x38+ terminal. When disabled,
                the firmware boots headless and uses whichever output sinks
                are configured below.

    endmenu

    menu "Output Sinks"

        config OUTPUT_HUMAN_LOG
            bool "Human-readable ESP_LOG output to UART"
            default y if !ENABLE_TUI
            default n
            help
                Routes ESP_LOG calls to the UART for direct viewing.
                Useful when running headless without the TUI. Safe to
                enable alongside the event stream; the two formats are
                visually distinct.

        config OUTPUT_EVENT_STREAM
            bool "Machine-readable JSONL event stream over UART"
            default n
            help
                Emits one JSON object per line for every published event
                (new contact, lost contact, position fix, etc) on a
                dedicated UART. Each line is prefixed with ASCII 0x1E
                and ends with LF so a host can resync mid-stream.

        config OUTPUT_EVENT_STREAM_UART_NUM
            int "Event stream UART number (0-4)"
            depends on OUTPUT_EVENT_STREAM
            default 2
            range 0 4
            help
                Which HP UART to use. UART0 is the console (TUI/log) -
                don't pick that. UART1 is the P25 diag channel (GPIO 32) -
                don't pick that either if P25_DIAG_UART is enabled.
                UART2 is a safe default.

        config OUTPUT_EVENT_STREAM_TX_GPIO
            int "Event stream TX GPIO"
            depends on OUTPUT_EVENT_STREAM
            default 17
            range 0 54
            help
                GPIO pin for the event stream UART TX. ESP32-P4 caveats:
                stay at 36 or lower to avoid LDO power-domain issues
                with higher GPIOs. Avoid 24/25 (USB-JTAG), 34-38
                (strapping pins), 46 (USB VBUS enable on this firmware),
                and 32 (P25 diag UART). Wire this pin to your host's RX.

    endmenu

    menu "Radio Apps"

        config APP_ADSB
            bool "ADS-B (1090 MHz Mode-S)"
            default y
            help
                Receives 1090 MHz extended squitter messages from aircraft
                using an RTL-SDR dongle. Decodes ICAO, callsign, altitude,
                velocity, heading, vertical rate, and CPR position pairs.

        config ADSB_RX_LAT_UDEG
            int "Receiver latitude (microdegrees)"
            depends on APP_ADSB
            default 0
            range -90000000 90000000
            help
                Latitude of the receiver in microdegrees (degrees * 1e6).
                Example: Laconia NH (43.5275 N) = 43527500.
                When set (non-zero), enables locally-unambiguous CPR
                decoding from the very first position frame, instead of
                waiting for an even/odd pair. Aircraft that send only one
                or two position squitters before drifting out of range
                will now produce a position fix.
                Leave at 0 to disable receiver-anchored local decoding;
                the firmware still does global decoding (even+odd pair)
                and per-aircraft local decoding from prior fixes.

        config ADSB_RX_LON_UDEG
            int "Receiver longitude (microdegrees)"
            depends on APP_ADSB
            default 0
            range -180000000 180000000
            help
                Longitude of the receiver in microdegrees (degrees * 1e6).
                Example: Laconia NH (71.5375 W) = -71537500. Negative for
                West, positive for East. See ADSB_RX_LAT_UDEG.

        config APP_VHF
            bool "VHF FM (scaffold)"
            default n
            help
                Scaffold for a future VHF FM receiver app. Registers with
                the app framework but does not yet decode anything. Enabling
                this currently has no runtime effect beyond making the app
                selectable from the multi-app cycle key.

        config APP_P25
            bool "P25 Phase 1 (digital voice)"
            default y
            help
                Project 25 Phase 1 (FDMA) digital voice decoder. Decodes
                C4FM and CQPSK on a single talkgroup at 154.785 MHz default
                (configurable). Includes BCH(63,16,11) NID correction,
                Reed-Solomon HDU/LDU correction, IMBE+ voice synthesis via
                mbelib, and a UART1 telemetry channel for diagnostics.

    endmenu

    menu "P25 Diagnostics"
        depends on APP_P25

        config P25_DIAG_UART
            bool "Enable UART1 telemetry channel"
            default y
            help
                When enabled, P25 emits one CSV-ish status line per
                second on UART1 (GPIO 32 TX / GPIO 33 RX, 921600 baud).
                Useful for inspecting BCH success rates, sync attempts,
                and frame counts without polluting the TUI.

    endmenu

endmenu
```

## sdkconfig.defaults
```kconfig
CONFIG_IDF_TARGET="esp32p4"
CONFIG_IDF_EXPERIMENTAL_FEATURES=y
CONFIG_ESPTOOLPY_FLASHMODE_QIO=y
CONFIG_ESPTOOLPY_FLASHSIZE_16MB=y
CONFIG_PARTITION_TABLE_CUSTOM=y
CONFIG_PARTITION_TABLE_CUSTOM_FILENAME="partitions.csv"
CONFIG_SPIRAM=y
CONFIG_SPIRAM_SPEED_200M=y
CONFIG_CACHE_L2_CACHE_256KB=y
CONFIG_CACHE_L2_CACHE_LINE_128B=y
CONFIG_USB_HOST_HW_BUFFER_BIAS_IN=y
CONFIG_USB_HOST_CONTROL_TRANSFER_MAX_SIZE=4096
CONFIG_USB_HOST_DEBOUNCE_DELAY_MS=500
CONFIG_USB_HOST_RESET_HOLD_MS=30
CONFIG_USB_HOST_RESET_RECOVERY_MS=300
CONFIG_USB_HOST_SET_ADDR_RECOVERY_MS=10
CONFIG_FREERTOS_HZ=1000
CONFIG_ESP_MAIN_TASK_STACK_SIZE=8192
CONFIG_FREERTOS_TASK_CREATE_ALLOW_EXT_MEM=y
CONFIG_ESP_TASK_WDT_TIMEOUT_S=10
# Disable task WDT monitoring of the CPU1 idle task. Core 1 runs our
# compute-bound DSP pipeline (p25_rx_task and dsd_decode, both priority
# 5), and the idle task can genuinely starve for multi-second stretches
# during sustained USB bulk reads + DSP + FD audio processing. The WDT
# warnings that result are just noise — nothing is actually stuck.
# CPU0 idle monitoring is still enabled (default), so infinite loops
# or hangs in TUI / USB host / diag / beep / fd_audio tasks are still
# caught.
CONFIG_ESP_TASK_WDT_CHECK_IDLE_TASK_CPU1=n

# ── Release-grade optimization ──────────────────────────────
# Default was -Og (debug), which is 5-10x slower than -O2 for
# our float-heavy DSP path. This is the single biggest factor
# in whether the RX pipeline can keep up with 960 kSPS from the
# RTL-SDR. -O2 + silent asserts is the standard release config.
#
# If debugging a crash, temporarily revert by commenting these
# out — -Og produces more readable backtraces.
CONFIG_COMPILER_OPTIMIZATION_PERF=y
CONFIG_COMPILER_OPTIMIZATION_ASSERTIONS_SILENT=y
CONFIG_APP_PROJECT_VER_FROM_CONFIG=y
CONFIG_APP_PROJECT_VER="1.0.0"
# Console routing: only UART0 (the FTDI-bridged USB CDC port) carries
# the TUI. Disable the USB-Serial-JTAG mirror so the TUI doesn't get
# duplicated across both endpoints when both PuTTY and idf.py monitor
# are open. To use idf.py monitor instead, swap to:
#   CONFIG_ESP_CONSOLE_USB_SERIAL_JTAG=y
#   # CONFIG_ESP_CONSOLE_UART_DEFAULT is not set
#   CONFIG_ESP_CONSOLE_SECONDARY_NONE=y
CONFIG_ESP_CONSOLE_UART_DEFAULT=y
CONFIG_ESP_CONSOLE_SECONDARY_NONE=y
# CONFIG_ESP_CONSOLE_SECONDARY_USB_SERIAL_JTAG is not set
```
